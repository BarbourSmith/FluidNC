// Copyright (c) 2024 Maslow CNC. All rights reserved.
// Use of this source code is governed by a GPLv3 license that can be found in the LICENSE file with
// following exception: it may not be used for any reason by MakerMade or anyone with a business or personal connection to MakerMade

#include "Maslow.h"
#include "../Report.h"
#include "../WebUI/WifiConfig.h"
#include "../Protocol.h"
#include "../System.h"
#include "../Stepper.h"
#include "../FileStream.h"
#include "../Kinematics/MaslowKinematics.h"
#include "../GCode.h"
#include <cmath>
#include "esp_task_wdt.h"

// VERSION_NUMBER is now generated by git-version.py
extern const char* VERSION_NUMBER;

// Maslow specific defines
#define TLEncoderLine 2
#define TREncoderLine 1
#define BLEncoderLine 3
#define BREncoderLine 0

#define motorPWMFreq 2000
#define motorPWMRes 10

#define tlIn1Pin 45
#define tlIn1Channel 0
#define tlIn2Pin 21
#define tlIn2Channel 1
#define tlADCPin 18

#define trIn1Pin 42
#define trIn1Channel 2
#define trIn2Pin 41
#define trIn2Channel 3
#define trADCPin 6

#define blIn1Pin 37
#define blIn1Channel 4
#define blIn2Pin 36
#define blIn2Channel 5
#define blADCPin 8

#define brIn1Pin 9
#define brIn1Channel 6
#define brIn2Pin 3
#define brIn2Channel 7
#define brADCPin 7

#define coolingFanPin 47

#define SERVOFAULT 40

#define ETHERNETLEDPIN 39
#define WIFILED 35
#define REDLED 14

// Maximum allowed interval between Maslow.update() calls before triggering emergency stop
#define UPDATE_WATCHDOG_MS 100

int ENCODER_READ_FREQUENCY_HZ = 1000;  //max frequency for polling the encoders

//------------------------------------------------------
//------------------------------------------------------ Main Function Loops
//------------------------------------------------------

// Initialization function
void Maslow_::begin(void (*sys_rt)()) {
    Wire.begin(5, 4, 200000);
    I2CMux.begin(TCAADDR, Wire);

    axis[_TL].begin(tlIn1Pin, tlIn2Pin, tlADCPin, TLEncoderLine, tlIn1Channel, tlIn2Channel);
    axis[_TR].begin(trIn1Pin, trIn2Pin, trADCPin, TREncoderLine, trIn1Channel, trIn2Channel);
    axis[_BL].begin(blIn1Pin, blIn2Pin, blADCPin, BLEncoderLine, blIn1Channel, blIn2Channel);
    axis[_BR].begin(brIn1Pin, brIn2Pin, brADCPin, BREncoderLine, brIn1Channel, brIn2Channel);

    calibration.axisHomed[_BL] = false;
    calibration.axisHomed[_BR] = false;
    calibration.axisHomed[_TR] = false;
    calibration.axisHomed[_TL] = false;

    //Recompute the center XY
    calibration.updateCenterXY();

    pinMode(coolingFanPin, OUTPUT);
    pinMode(ETHERNETLEDPIN, OUTPUT);
    pinMode(WIFILED, OUTPUT);
    pinMode(REDLED, OUTPUT);

    digitalWrite(ETHERNETLEDPIN, LOW);
    digitalWrite(REDLED, LOW);

    pinMode(SERVOFAULT, INPUT);

    lastCallToUpdate = millis();

    // Only load positions from NVS on the first call to begin() (initial power-on)
    // Subsequent calls (e.g., after soft reset) should not reload stale NVS data
    static bool positionsLoaded = false;
    if (!positionsLoaded) {
        loadZPos();           //Loads the z-axis position from EEPROM
        loadBeltPositions();  //Loads the belt positions from EEPROM
        positionsLoaded = true;
    }

    stopMotors();

    Wire.setTimeOut(10);

    if (error) {
        log_error(M + " failed to initialize - fix errors and restart");
    } else {
        log_info("Starting " + M + " Version " << VERSION_NUMBER);
        log_info("Maslow_Retract_Current_Threshold: " << calibration.retractCurrentThreshold);
    }
}

// Maslow main loop, everything is processed here
void Maslow_::update() {
    // Register with hardware watchdog on first call and feed it every call.
    // If update() stops being called entirely (Core 1 frozen), the hardware
    // watchdog will reset the device, stopping all PWM outputs.
    static bool wdt_registered = false;
    if (!wdt_registered) {
        if (esp_task_wdt_add(NULL) == ESP_OK) {
            log_info("Maslow update loop registered with hardware watchdog");
        } else {
            log_warn("Could not register Maslow update loop with hardware watchdog");
        }
        wdt_registered = true;
    }
    esp_task_wdt_reset();

    static State prevState = sys.state();

    // Watchdog fired: rapid double-blink on both RED and WiFi LEDs (distinct from the slow
    // 300 ms error blink).  Triggered when update() is not called for > UPDATE_WATCHDOG_MS.
    // Pattern: 100 ms ON, 100 ms OFF, 100 ms ON, 800 ms pause (repeating).
    // Both LEDs flash together so the pattern is visible from any angle.
    // Recovery: power-cycle the machine.
    if (watchdogFired) {
        stopMotors();
        static unsigned long wdTimer  = millis();
        static int           wdPhase  = 0;  // 0=on1, 1=off1, 2=on2, 3=pause
        static const int     wdMS[]   = { 100, 100, 100, 800 };
        if (millis() - wdTimer >= (unsigned long)wdMS[wdPhase]) {
            wdPhase = (wdPhase + 1) % 4;
            bool ledsOn = (wdPhase == 0 || wdPhase == 2);
            digitalWrite(REDLED, ledsOn ? HIGH : LOW);
            digitalWrite(WIFILED, ledsOn ? HIGH : LOW);
            wdTimer = millis();
        }
        return;
    }

    // Error / emergency-stop state: slow 300 ms single-blink on the RED LED only.
    // Triggered by eStop() (position error > 15 mm while running, $ESTOP command) or by
    // a hardware fault detected at startup (encoder or motor not found).
    // The machine ignores all movement commands while in this state.
    // Recovery: fix the underlying cause (check console log for details), then power-cycle.
    if (error) {
        static unsigned long timer = millis();
        static bool          st    = true;  //This is used to blink the LED
        if (millis() - timer > 300) {
            stopMotors();
            st = !st;
            digitalWrite(REDLED, st);
            timer = millis();
            if (errorMessage != "") {
                log_error(errorMessage.c_str());
            }
            errorMessage = "";
        }
        return;
    }

    //Blinks the Ethernet LEDs randomly...these have been removed from the board, this pin should be freed up
    if (random(10000) == 0) {
        digitalWrite(ETHERNETLEDPIN, LOW);
    }
    if (random(10000) == 0) {
        digitalWrite(ETHERNETLEDPIN, HIGH);
    }

    //Save the z-axis position if the prevous state was jog or cycle and the current state is idle
    if ((prevState == State::Jog || prevState == State::Cycle) && sys.state() == State::Idle) {
        saveZPos();
        // Only save belt positions when in READY_TO_CUT, RETRACTED, or EXTENDEDOUT state (belts are tight and valid)
        int currentMaslowState = calibration.getCurrentState();
        if (currentMaslowState == READY_TO_CUT || currentMaslowState == RETRACTED || currentMaslowState == EXTENDEDOUT) {
            saveBeltPositions();
        }
    }

    // Track state changes and mark belt positions as stale when leaving valid states
    static int prevMaslowState    = calibration.getCurrentState();
    int        currentMaslowState = calibration.getCurrentState();
    if (prevMaslowState != currentMaslowState) {
        // If we're leaving READY_TO_CUT, RETRACTED, or EXTENDEDOUT, mark positions as stale
        if ((prevMaslowState == READY_TO_CUT || prevMaslowState == RETRACTED || prevMaslowState == EXTENDEDOUT) &&
            (currentMaslowState != READY_TO_CUT && currentMaslowState != RETRACTED && currentMaslowState != EXTENDEDOUT)) {
            markBeltPositionsStale();
        }
        prevMaslowState = currentMaslowState;
    }

    blinkIPAddress();

    //Make sure we're running maslow config file
    if (!Maslow.using_default_config) {
        unsigned long now = millis();
        //if the update function is not being called enough, stop everything to prevent damage
        // Skip the watchdog check during file/firmware uploads: flash write operations stall
        // both CPU cores, so update() may not run for > UPDATE_WATCHDOG_MS through no fault
        // of the motion system.  lastCallToUpdate is still refreshed so the watchdog does not
        // trigger immediately after the upload finishes.
        if (!uploadInProgress && now - lastCallToUpdate > UPDATE_WATCHDOG_MS) {
            unsigned int elapsedTime = now - lastCallToUpdate;
            log_error("Emergency stop. Update function not being called enough. " << elapsedTime << "ms since last call");
            watchdogFired = true;
            Maslow.panic();
        }
        lastCallToUpdate = now;

        Maslow.updateEncoderPositions();  //We always update encoder positions in any state,

        for (int arm = _TL; arm < ARM_COUNT; arm++) {
            axis[arm].update();  //update motor currents and belt speeds like this for now
        }

        if (safetyOn)
            safety_control();

        //quick solution for delay without blocking
        if (calibration.holding && millis() - calibration.holdTimer > calibration.holdTime) {
            calibration.holding = false;
        } else if (calibration.holding)
            return;

        //temp test function...This is used for debugging when the test command is sent
        if (test) {
            test = false;
        }

        //------------------------ Maslow State Machine

        //-------Jog or G-code execution.
        if (sys.state() == State::Jog || sys.state() == State::Cycle || sys.state() == State::Hold) {
            // With MaslowKinematics, read belt motor positions directly from the axis system
            // Axis mapping: A=TL, B=TR, C=BL, D=BR, Z=Router
            float beltLength[ARM_COUNT];
            beltLength[_TL] = steps_to_mpos(get_axis_motor_steps(0), 0);  // TL from A axis (axis 0)
            beltLength[_TR] = steps_to_mpos(get_axis_motor_steps(1), 1);  // TR from B axis (axis 1)
            beltLength[_BL] = steps_to_mpos(get_axis_motor_steps(2), 2);  // BL from C axis (axis 2)
            beltLength[_BR] = steps_to_mpos(get_axis_motor_steps(3), 3);  // BR from D axis (axis 3)
            float zPosition = steps_to_mpos(get_axis_motor_steps(4), 4);  // Z from Z axis (axis 4)

            // Set individual belt targets using the computed positions
            for (int arm = _TL; arm < ARM_COUNT; arm++) {
                axis[arm].setTarget(beltLength[arm]);
            }

            // Update internal target tracking for getTargetX/Y/Z functions
            // For now, we'll use the Z position directly and estimate X,Y from frame center
            // A full implementation would require solving inverse kinematics from belt lengths
            targetZ = zPosition;
            // Simple approximation - this could be improved with proper inverse kinematics
            // For now, we'll assume we're near the center if we don't have better information
            if (targetX == 0 && targetY == 0) {
                using namespace Kinematics;
                MaslowKinematics* kinematics = getMaslowKinematics();
                if (kinematics) {
                    targetX = (kinematics->getTrX() + kinematics->getBlX()) / 2.0f - kinematics->getCenterX();  // Approximate center X
                    targetY = (kinematics->getTrY() + kinematics->getBlY()) / 2.0f - kinematics->getCenterY();  // Approximate center Y
                }
            }

            //We used to call Maslow.setTargets() here, but now we use the axis system directly

            //This disables the belt motors until the user has completed calibration or apply tension and they have succeeded
            if (calibration.currentState == READY_TO_CUT) {
                Maslow.recomputePID();
            }
        }
        //--------Homing routines
        else if (sys.state() == State::Homing) {
            calibration.home();
        } else {  //This is confusing to understand. This is an else if so this is only run if we are not in jog, cycle, or homing
            // Clear any motor override flags to ensure motors stop
            calibration.clearMotorOverrides();
            Maslow.stopMotors();
        }

        //If we are in any state other than idle or alarm turn the cooling fan on
        if (sys.state() != State::Idle && sys.state() != State::Alarm) {
            digitalWrite(coolingFanPin, HIGH);  //keep the cooling fan on
        }
        //If we are doing calibration turn the cooling fan on
        else if (calibration.calibrationInProgress || calibration.getCurrentState() == EXTENDING ||
                 calibration.getCurrentState() == RETRACTING || calibration.getCurrentState() == RELEASE_TENSION) {
            digitalWrite(coolingFanPin, HIGH);  //keep the cooling fan on
        } else {
            digitalWrite(coolingFanPin, LOW);  //Turn the cooling fan off
        }

        //------------------------ End of Maslow State Machine

        print_motor_currents();
    }

    prevState = sys.state();  //Store for next time
}

//------------------------------------------------------
//------------------------------------------------------ Position Control Functions
//------------------------------------------------------

//updating encoder positions for all 4 arms, cycling through them each call, at ENCODER_READ_FREQUENCY_HZ frequency
bool Maslow_::updateEncoderPositions() {
    bool                 success               = true;
    static unsigned long lastCallToEncoderRead = millis();

    static int           encoderFailCounter[4] = { 0, 0, 0, 0 };
    static unsigned long encoderFailTimer      = millis();

    if (!readingFromSD && (millis() - lastCallToEncoderRead > 1000 / (ENCODER_READ_FREQUENCY_HZ))) {
        static int encoderToRead = 0;
        switch (encoderToRead) {
            case 0:
                if (!axis[_TL].updateEncoderPosition()) {
                    encoderFailCounter[TLEncoderLine]++;
                }
                break;
            case 1:
                if (!axis[_TR].updateEncoderPosition()) {
                    encoderFailCounter[TREncoderLine]++;
                }
                break;
            case 2:
                if (!axis[_BL].updateEncoderPosition()) {
                    encoderFailCounter[BLEncoderLine]++;
                }
                break;
            case 3:
                if (!axis[_BR].updateEncoderPosition()) {
                    encoderFailCounter[BREncoderLine]++;
                }
                break;
        }
        encoderToRead++;
        if (encoderToRead > 3) {
            encoderToRead         = 0;
            lastCallToEncoderRead = millis();
        }
    }

    // if more than 1% of readings fail, warn user, if more than 10% fail, stop the machine and raise alarm
    if (millis() - encoderFailTimer > 1000) {
        for (int i = 0; i < 4; i++) {
            //turn i into proper label
            String label = axis_id_to_label(i);
            if (encoderFailCounter[i] > 0.1 * ENCODER_READ_FREQUENCY_HZ) {
                // log error statement with appropriate label
                log_error("Failure on " << label.c_str() << " encoder, failed to read " << encoderFailCounter[i]
                                        << " times in the last second");
                Maslow.panic();
            } else if (encoderFailCounter[i] > 0) {  //0.01*ENCODER_READ_FREQUENCY_HZ){
                log_warn("Bad connection on " << label.c_str() << " encoder, failed to read " << encoderFailCounter[i]
                                              << " times in the last second");
            }
            encoderFailCounter[i] = 0;
            encoderFailTimer      = millis();
        }
    }

    return success;
}

// This computes the target lengths of the belts based on the target x and y coordinates and sends that information to each arm.
void Maslow_::setTargets(float xTarget, float yTarget, float zTarget, bool tl, bool tr, bool bl, bool br) {
    //Store the target x and y coordinates for the getTargetN() functions
    targetX = xTarget;
    targetY = yTarget;
    targetZ = zTarget;

    using namespace Kinematics;
    MaslowKinematics* kinematics = getMaslowKinematics();
    if (!kinematics) {
        log_error("MaslowKinematics not available");
        return;
    }

    if (tl) {
        axis[_TL].setTarget(kinematics->computeTL(xTarget, yTarget, zTarget));
    }
    if (tr) {
        axis[_TR].setTarget(kinematics->computeTR(xTarget, yTarget, zTarget));
    }
    if (bl) {
        axis[_BL].setTarget(kinematics->computeBL(xTarget, yTarget, zTarget));
    }
    if (br) {
        axis[_BR].setTarget(kinematics->computeBR(xTarget, yTarget, zTarget));
    }
}

void Maslow_::setEncoderGeometry(float beltToothSpacing, float encoderTeeth) {
    for (int arm = _TL; arm < ARM_COUNT; arm++) {
        axis[arm].setEncoderGeometry(beltToothSpacing, encoderTeeth);
    }
}

// Get's the most recently set target position in X
double Maslow_::getTargetX() {
    return targetX;
}

// Get's the most recently set target position in Y
double Maslow_::getTargetY() {
    return targetY;
}

//Get's the most recently set target position in Z
double Maslow_::getTargetZ() {
    return targetZ;
}

//updates motor powers for all axis, based on targets set by setTargets()
void Maslow_::recomputePID() {
    axis[_BL].recomputePID();
    axis[_BR].recomputePID();
    axis[_TR].recomputePID();
    axis[_TL].recomputePID();

    digitalWrite(coolingFanPin, HIGH);  //keep the cooling fan on

    if (digitalRead(SERVOFAULT) ==
        1) {  //The servo drives have a fault pin that goes high when there is a fault (ie one over heats). We should probably call panic here. Also this should probably be read in the main loop
        log_info("Servo fault!");
    }
}

//------------
// Z-Axis Functions
//------------

//This function saves the current z-axis position to the non-volitle storage
void Maslow_::saveZPos() {
    nvs_handle_t nvsHandle;
    esp_err_t    ret = nvs_open("maslow", NVS_READWRITE, &nvsHandle);
    if (ret != ESP_OK) {
        log_info("Error " + std::string(esp_err_to_name(ret)) + " opening NVS handle!\n");
        return;
    }

    // Read the current value
    int32_t currentZPos;
    ret = nvs_get_i32(nvsHandle, "zPos", &currentZPos);
    if (ret != ESP_OK && ret != ESP_ERR_NVS_NOT_FOUND) {
        log_info("Error " + std::string(esp_err_to_name(ret)) + " reading from NVS!\n");
        return;
    }

    // Write - Convert the float to an int32_t and write only if it has changed
    union FloatInt32 {
        float   f;
        int32_t i;
    };
    FloatInt32 fi;
    fi.f = targetZ;
    if (ret == ESP_ERR_NVS_NOT_FOUND || currentZPos != fi.i) {  // Only write if the value has changed
        ret = nvs_set_i32(nvsHandle, "zPos", fi.i);
        if (ret != ESP_OK) {
            log_info("Error " + std::string(esp_err_to_name(ret)) + " writing to NVS!\n");
        } else {
            //log_info("Written value = " + std::to_string(targetZ));

            // Commit written value to non-volatile storage
            ret = nvs_commit(nvsHandle);
            if (ret != ESP_OK) {
                log_info("Error " + std::string(esp_err_to_name(ret)) + " committing changes to NVS!\n");
            }
        }
    }
}

//This function loads the z-axis position from the non-volitle storage
float Maslow_::currentZHome() const {
    float zHome = gc_state.coord_system[Z_AXIS] + gc_state.coord_offset[Z_AXIS];
    if (Z_AXIS == TOOL_LENGTH_OFFSET_AXIS) {
        zHome += gc_state.tool_length_offset;
    }
    return zHome;
}

void Maslow_::loadZPos() {
    static constexpr float MIN_VALID_Z_MM = 0.0f;
    static constexpr float MAX_VALID_Z_MM = 72.0f;

    nvs_handle_t nvsHandle;
    esp_err_t    ret = nvs_open("maslow", NVS_READWRITE, &nvsHandle);
    if (ret != ESP_OK) {
        log_info("Error " + std::string(esp_err_to_name(ret)) + " opening NVS handle!\n");
        return;
    }

    // Read
    int32_t value2;
    ret = nvs_get_i32(nvsHandle, "zPos", &value2);
    if (ret != ESP_OK) {
        log_info("Error " + std::string(esp_err_to_name(ret)) + " reading from NVS!");
    } else {
        union FloatInt32 {
            float   f;
            int32_t i;
        };
        FloatInt32 fi;
        fi.i    = value2;
        targetZ = fi.f;

        // gc_state is zero-initialized before gc_init() runs, so if coordinate
        // offsets are not loaded yet, Z home safely defaults to 0 here.
        float zHome = currentZHome();

        float zPosition = targetZ - zHome;
        bool zPositionOutOfRange = !std::isfinite(targetZ) || targetZ < MIN_VALID_Z_MM || targetZ > MAX_VALID_Z_MM;
        bool zHomeOutOfRange = !std::isfinite(zHome) || zHome < MIN_VALID_Z_MM || zHome > MAX_VALID_Z_MM;

        if (zPositionOutOfRange) {
            log_warn("Maslow Z position warning: Z position out of range, check Z home is valid (Z home=" << zHome << "mm, Z position=" << zPosition
                                                                                                           << "mm, Z home + Z position=" << targetZ
                                                                                                           << "mm). Valid range is 0 to 72mm inclusive. Power cycling Maslow may clear error.");
        }

        if (zHomeOutOfRange) {
            log_warn("Maslow Z home reset warning: Startup Z home is out of range (Zm=" << targetZ << "mm, Z home=" << zHome
                                                                                          << "mm). Valid range for Z home is 0 to 72mm inclusive. Resetting Z home to Zm.");
        }

        // Use Z_AXIS constant (2) for cartesian coordinate, not motor index (4)
        float* mpos  = get_mpos();
        mpos[Z_AXIS] = targetZ;
        set_motor_steps_from_mpos(mpos);

        log_info("Current z-axis position loaded as: " << targetZ);

        gc_sync_position();  //This updates the Gcode engine with the new position from the stepping engine that we set with set_motor_steps
        plan_sync_position();

        if (zHomeOutOfRange) {
            // Reset Z home to Zm by clearing any transient G92 offset and then setting the
            // work coordinate system so that work Z = 0 at the current machine position (Zm).
            char  clear_offset_line[] = "G92.1";
            Error result              = gc_execute_line(clear_offset_line);
            if (result != Error::Ok) {
                log_error("Failed to clear transient Z home offset: " << errorString(result));
            } else {
                char set_home_line[] = "G10 L20 P0 Z0";
                result               = gc_execute_line(set_home_line);
                if (result != Error::Ok) {
                    log_error("Failed to set work coordinate Z home to Zm: " << errorString(result));
                }
            }
        }
    }
}

void Maslow_::logLoadZPosDebug() {
    float zHome = currentZHome();
    float zPosition = targetZ - zHome;
    log_info("Zm=" << targetZ << "mm, Z home=" << zHome << "mm, Z position=" << zPosition << "mm");
}

/** Sets the 'bottom' Z position, this is a 'stop' beyond which travel cannot continue */
void Maslow_::setZStop() {
    targetZ = 0;

    // Use Z_AXIS constant (2) for cartesian coordinate, not motor index (4)
    float* mpos  = get_mpos();
    mpos[Z_AXIS] = targetZ;
    set_motor_steps_from_mpos(mpos);

    gc_sync_position();  //This updates the Gcode engine with the new position from the stepping engine that we set with set_motor_steps
    plan_sync_position();

    // Persist Z home at 0 by clearing transient G92 offset and updating the
    // active work coordinate system at the current machine position.
    char  clear_offset_line[] = "G92.1";
    Error result              = gc_execute_line(clear_offset_line);
    if (result != Error::Ok) {
        log_error("Failed to clear transient Z home offset: " << errorString(result));
        return;
    }

    char set_home_line[] = "G10 L20 P0 Z0";
    result               = gc_execute_line(set_home_line);
    if (result != Error::Ok) {
        log_error("Failed to set persistent Z home: " << errorString(result));
    }
}

//This function saves the current belt positions to non-volatile storage
void Maslow_::saveBeltPositions() {
    // Only save if in a valid state (belts are tight and at known positions)
    int currentState = calibration.getCurrentState();
    if (currentState != READY_TO_CUT && currentState != RETRACTED && currentState != EXTENDEDOUT) {
        log_debug("Belt positions NOT saved - invalid state (not READY_TO_CUT, RETRACTED, or EXTENDEDOUT), currentState=" << currentState);
        return;
    }

    nvs_handle_t nvsHandle;
    esp_err_t    ret = nvs_open("maslow", NVS_READWRITE, &nvsHandle);
    if (ret != ESP_OK) {
        log_info("Error " + std::string(esp_err_to_name(ret)) + " opening NVS handle for belt positions!\n");
        return;
    }

    // Union for float to int32_t conversion
    union FloatInt32 {
        float   f;
        int32_t i;
    };

    // Get current belt positions
    float tlPos = axis[_TL].getPosition();
    float trPos = axis[_TR].getPosition();
    float blPos = axis[_BL].getPosition();
    float brPos = axis[_BR].getPosition();

    // Get current raw encoder angles for validation on restore
    uint16_t tlAngle = axis[_TL].getRawEncoderAngle();
    uint16_t trAngle = axis[_TR].getRawEncoderAngle();
    uint16_t blAngle = axis[_BL].getRawEncoderAngle();
    uint16_t brAngle = axis[_BR].getRawEncoderAngle();

    // Save TL belt position
    int32_t currentTLPos;
    ret = nvs_get_i32(nvsHandle, "tlPos", &currentTLPos);
    FloatInt32 tlFi;
    tlFi.f = tlPos;
    if (ret == ESP_ERR_NVS_NOT_FOUND || currentTLPos != tlFi.i) {
        ret = nvs_set_i32(nvsHandle, "tlPos", tlFi.i);
        if (ret != ESP_OK) {
            log_info("Error " + std::string(esp_err_to_name(ret)) + " writing TL belt position to NVS!\n");
        }
    }
    // Save TL raw encoder angle
    nvs_set_i32(nvsHandle, "tlAngle", tlAngle);

    // Save TR belt position
    int32_t currentTRPos;
    ret = nvs_get_i32(nvsHandle, "trPos", &currentTRPos);
    FloatInt32 trFi;
    trFi.f = trPos;
    if (ret == ESP_ERR_NVS_NOT_FOUND || currentTRPos != trFi.i) {
        ret = nvs_set_i32(nvsHandle, "trPos", trFi.i);
        if (ret != ESP_OK) {
            log_info("Error " + std::string(esp_err_to_name(ret)) + " writing TR belt position to NVS!\n");
        }
    }
    // Save TR raw encoder angle
    nvs_set_i32(nvsHandle, "trAngle", trAngle);

    // Save BL belt position
    int32_t currentBLPos;
    ret = nvs_get_i32(nvsHandle, "blPos", &currentBLPos);
    FloatInt32 blFi;
    blFi.f = blPos;
    if (ret == ESP_ERR_NVS_NOT_FOUND || currentBLPos != blFi.i) {
        ret = nvs_set_i32(nvsHandle, "blPos", blFi.i);
        if (ret != ESP_OK) {
            log_info("Error " + std::string(esp_err_to_name(ret)) + " writing BL belt position to NVS!\n");
        }
    }
    // Save BL raw encoder angle
    nvs_set_i32(nvsHandle, "blAngle", blAngle);

    // Save BR belt position
    int32_t currentBRPos;
    ret = nvs_get_i32(nvsHandle, "brPos", &currentBRPos);
    FloatInt32 brFi;
    brFi.f = brPos;
    if (ret == ESP_ERR_NVS_NOT_FOUND || currentBRPos != brFi.i) {
        ret = nvs_set_i32(nvsHandle, "brPos", brFi.i);
        if (ret != ESP_OK) {
            log_info("Error " + std::string(esp_err_to_name(ret)) + " writing BR belt position to NVS!\n");
        }
    }
    // Save BR raw encoder angle
    nvs_set_i32(nvsHandle, "brAngle", brAngle);

    // Mark the data as valid
    ret = nvs_set_i32(nvsHandle, "beltValid", 1);
    if (ret != ESP_OK) {
        log_info("Error " + std::string(esp_err_to_name(ret)) + " writing belt validity marker to NVS!\n");
    }

    // Commit all changes to non-volatile storage
    ret = nvs_commit(nvsHandle);
    if (ret != ESP_OK) {
        log_info("Error " + std::string(esp_err_to_name(ret)) + " committing belt position changes to NVS!\n");
    }

    nvs_close(nvsHandle);

    // Log the save operation
    char* buffer = getLogBuffer();
    snprintf(buffer, 1400, "Belt positions saved to NVS: TL=%g TR=%g BL=%g BR=%g state=%d", tlPos, trPos, blPos, brPos, currentState);
    log_debug(buffer);
    releaseLogBuffer();
}

//This function loads the belt positions from non-volatile storage
void Maslow_::loadBeltPositions() {
    nvs_handle_t nvsHandle;
    esp_err_t    ret = nvs_open("maslow", NVS_READWRITE, &nvsHandle);
    if (ret != ESP_OK) {
        log_info("Error " + std::string(esp_err_to_name(ret)) + " opening NVS handle for belt positions!\n");
        return;
    }

    // Check if the data is valid
    int32_t validityMarker;
    ret = nvs_get_i32(nvsHandle, "beltValid", &validityMarker);
    if (ret != ESP_OK || validityMarker != 1) {
        log_debug("Belt positions NOT loaded from NVS - data is stale/invalid or not found");
        if (ret == ESP_ERR_NVS_NOT_FOUND) {
            log_info("No saved belt positions found in NVS - machine will remain in UNKNOWN state until belts are calibrated/extended");
        } else if (validityMarker != 1) {
            log_info("Saved belt positions in NVS are marked as stale/invalid (value="
                     << validityMarker << ") - machine will remain in UNKNOWN state until belts are calibrated/extended");
        }
        nvs_close(nvsHandle);
        return;
    }

    // Union for int32_t to float conversion
    union FloatInt32 {
        float   f;
        int32_t i;
    };

    // Load TL belt position
    int32_t tlValue;
    ret         = nvs_get_i32(nvsHandle, "tlPos", &tlValue);
    float tlPos = 0;
    if (ret == ESP_OK) {
        FloatInt32 tlFi;
        tlFi.i = tlValue;
        tlPos  = tlFi.f;

        // Load saved encoder angle and compare with current
        int32_t savedTLAngle;
        ret = nvs_get_i32(nvsHandle, "tlAngle", &savedTLAngle);
        if (ret == ESP_OK) {
            uint16_t currentTLAngle = axis[_TL].getRawEncoderAngle();
            int32_t  angleDiff      = currentTLAngle - savedTLAngle;

            // Handle wrap-around: if difference is > 2048, it wrapped the other direction
            if (angleDiff > 2048)
                angleDiff -= 4096;
            if (angleDiff < -2048)
                angleDiff += 4096;

            // If angle difference is within 1/4 turn (1024 counts), adjust belt position for small movement
            if (abs(angleDiff) < 1024) {
                float movementMM = (angleDiff / 4096.0f) * axis[_TL].getMmPerRevolution() * -1.0f;
                tlPos += movementMM;
            } else {
                log_info("TL encoder angle difference too large (" << angleDiff << " counts), treating belt positions as stale");
                nvs_close(nvsHandle);
                return;
            }
        }

        // Set motor steps directly for TL belt (A axis = motor 0)
        set_motor_steps(0, mpos_to_steps(tlPos, 0));
        axis[_TL].setTarget(tlPos);
        // Initialize encoder cumulative position to match adjusted belt length
        axis[_TL].setPosition(tlPos);
    } else if (ret != ESP_ERR_NVS_NOT_FOUND) {
        log_info("Error " + std::string(esp_err_to_name(ret)) + " reading TL belt position from NVS!");
    }

    // Load TR belt position
    int32_t trValue;
    ret         = nvs_get_i32(nvsHandle, "trPos", &trValue);
    float trPos = 0;
    if (ret == ESP_OK) {
        FloatInt32 trFi;
        trFi.i = trValue;
        trPos  = trFi.f;

        // Load saved encoder angle and compare with current
        int32_t savedTRAngle;
        ret = nvs_get_i32(nvsHandle, "trAngle", &savedTRAngle);
        if (ret == ESP_OK) {
            uint16_t currentTRAngle = axis[_TR].getRawEncoderAngle();
            int32_t  angleDiff      = currentTRAngle - savedTRAngle;

            // Handle wrap-around
            if (angleDiff > 2048)
                angleDiff -= 4096;
            if (angleDiff < -2048)
                angleDiff += 4096;

            if (abs(angleDiff) < 1024) {
                float movementMM = (angleDiff / 4096.0f) * axis[_TR].getMmPerRevolution() * -1.0f;
                trPos += movementMM;
            } else {
                log_info("TR encoder angle difference too large (" << angleDiff << " counts), treating belt positions as stale");
                nvs_close(nvsHandle);
                return;
            }
        }

        // Set motor steps directly for TR belt (B axis = motor 1)
        set_motor_steps(1, mpos_to_steps(trPos, 1));
        axis[_TR].setTarget(trPos);
        axis[_TR].setPosition(trPos);
    } else if (ret != ESP_ERR_NVS_NOT_FOUND) {
        log_info("Error " + std::string(esp_err_to_name(ret)) + " reading TR belt position from NVS!");
    }

    // Load BL belt position
    int32_t blValue;
    ret         = nvs_get_i32(nvsHandle, "blPos", &blValue);
    float blPos = 0;
    if (ret == ESP_OK) {
        FloatInt32 blFi;
        blFi.i = blValue;
        blPos  = blFi.f;

        // Load saved encoder angle and compare with current
        int32_t savedBLAngle;
        ret = nvs_get_i32(nvsHandle, "blAngle", &savedBLAngle);
        if (ret == ESP_OK) {
            uint16_t currentBLAngle = axis[_BL].getRawEncoderAngle();
            int32_t  angleDiff      = currentBLAngle - savedBLAngle;

            // Handle wrap-around
            if (angleDiff > 2048)
                angleDiff -= 4096;
            if (angleDiff < -2048)
                angleDiff += 4096;

            if (abs(angleDiff) < 1024) {
                float movementMM = (angleDiff / 4096.0f) * axis[_BL].getMmPerRevolution() * -1.0f;
                blPos += movementMM;
            } else {
                log_info("BL encoder angle difference too large (" << angleDiff << " counts), treating belt positions as stale");
                nvs_close(nvsHandle);
                return;
            }
        }

        // Set motor steps directly for BL belt (C axis = motor 2)
        set_motor_steps(2, mpos_to_steps(blPos, 2));
        axis[_BL].setTarget(blPos);
        axis[_BL].setPosition(blPos);
    } else if (ret != ESP_ERR_NVS_NOT_FOUND) {
        log_info("Error " + std::string(esp_err_to_name(ret)) + " reading BL belt position from NVS!");
    }

    // Load BR belt position
    int32_t brValue;
    ret         = nvs_get_i32(nvsHandle, "brPos", &brValue);
    float brPos = 0;
    if (ret == ESP_OK) {
        FloatInt32 brFi;
        brFi.i = brValue;
        brPos  = brFi.f;

        // Load saved encoder angle and compare with current
        int32_t savedBRAngle;
        ret = nvs_get_i32(nvsHandle, "brAngle", &savedBRAngle);
        if (ret == ESP_OK) {
            uint16_t currentBRAngle = axis[_BR].getRawEncoderAngle();
            int32_t  angleDiff      = currentBRAngle - savedBRAngle;

            // Handle wrap-around
            if (angleDiff > 2048)
                angleDiff -= 4096;
            if (angleDiff < -2048)
                angleDiff += 4096;

            if (abs(angleDiff) < 1024) {
                float movementMM = (angleDiff / 4096.0f) * axis[_BR].getMmPerRevolution() * -1.0f;
                brPos += movementMM;
            } else {
                log_info("BR encoder angle difference too large (" << angleDiff << " counts), treating belt positions as stale");
                nvs_close(nvsHandle);
                return;
            }
        }

        // Set motor steps directly for BR belt (D axis = motor 3)
        set_motor_steps(3, mpos_to_steps(brPos, 3));
        axis[_BR].setTarget(brPos);
        axis[_BR].setPosition(brPos);
    } else if (ret != ESP_ERR_NVS_NOT_FOUND) {
        log_info("Error " + std::string(esp_err_to_name(ret)) + " reading BR belt position from NVS!");
    }

    nvs_close(nvsHandle);

    // Sync position with G-code parser and planner
    gc_sync_position();
    plan_sync_position();

    // Determine the state based on belt lengths
    // If all belt lengths are near zero (within threshold), go to RETRACTED state, otherwise EXTENDEDOUT
    // Loading into EXTENDEDOUT requires the user to press "Apply Tension" to enter READY_TO_CUT state,
    // which allows the machine to measure its frame and verify everything is as expected
    // Use threshold of 0.5mm to account for encoder drift and small movements during save/restore
    const float retractedThreshold = 0.5;  // mm
    bool        allNearZero = (fabs(tlPos) < retractedThreshold && fabs(trPos) < retractedThreshold && fabs(blPos) < retractedThreshold &&
                        fabs(brPos) < retractedThreshold);
    int         newState    = allNearZero ? RETRACTED : EXTENDEDOUT;

    // Set the state directly (bypass requestStateChange validation)
    // This is appropriate when restoring a known-good saved state at boot time
    // requestStateChange() would reject EXTENDEDOUT from UNKNOWN state
    calibration.currentState = newState;

    // Set the extended* state variables in the Calibration class to match the restored state
    // When belts are extended (EXTENDEDOUT), mark all belts as extended
    // When belts are retracted (RETRACTED), mark all belts as not extended
    if (newState == EXTENDEDOUT) {
        calibration.setExtendedState(true, true, true, true);
        log_debug("Set Find Anchors extended* variables to true (belts are extended)");
    } else {
        calibration.setExtendedState(false, false, false, false);
        log_debug("Set Find Anchors extended* variables to false (belts are retracted)");
    }

    // Disable alarm if present
    if (sys.state() == State::Alarm) {
        sys.set_state(State::Idle);
    }
    char* buffer2 = getLogBuffer();
    snprintf(
        buffer2, 1400, "Belt positions after encoder adjustment: TL=%g TR=%g BL=%g BR=%g newState=%d", tlPos, trPos, blPos, brPos, newState);
    log_debug(buffer2);
    releaseLogBuffer();
}

//This function marks the belt positions in NVS as stale/invalid
void Maslow_::markBeltPositionsStale() {
    nvs_handle_t nvsHandle;
    esp_err_t    ret = nvs_open("maslow", NVS_READWRITE, &nvsHandle);
    if (ret != ESP_OK) {
        log_info("Error " + std::string(esp_err_to_name(ret)) + " opening NVS handle for belt positions!\n");
        return;
    }

    // Read the current validity marker value
    int32_t currentValid;
    ret = nvs_get_i32(nvsHandle, "beltValid", &currentValid);

    // Only write if the value needs to change (not already 0)
    // This preserves NVS write cycles since NVS has a finite write limit
    if (ret == ESP_ERR_NVS_NOT_FOUND || currentValid != 0) {
        // Mark the data as invalid by setting validity marker to 0
        ret = nvs_set_i32(nvsHandle, "beltValid", 0);
        if (ret != ESP_OK) {
            log_info("Error " + std::string(esp_err_to_name(ret)) + " writing belt validity marker to NVS!\n");
        } else {
            // Commit the change
            ret = nvs_commit(nvsHandle);
            if (ret != ESP_OK) {
                log_info("Error " + std::string(esp_err_to_name(ret)) + " committing belt validity change to NVS!\n");
            }
        }
    }

    nvs_close(nvsHandle);

    int currentState = calibration.getCurrentState();
    log_debug("Belt positions marked as stale/invalid in NVS, state=" << currentState);
}

//------------------------------------------------------
//------------------------------------------------------ Utility Functions
//------------------------------------------------------

// int to string name conversion for axis labels
String Maslow_::axis_id_to_label(int axis_id) {
    String label;
    switch (axis_id) {
        case TLEncoderLine:
            label = "Top Left";
            break;
        case TREncoderLine:
            label = "Top Right";
            break;
        case BREncoderLine:
            label = "Bottom Right";
            break;
        case BLEncoderLine:
            label = "Bottom Left";
            break;
    }
    return label;
}

//Runs the self test feature
void Maslow_::test_() {
    log_info("Firmware Version: " << VERSION_NUMBER);

    log_info("I2C Timeout: ");
    log_info(Wire.getTimeOut());

    for (int arm = _TL; arm < ARM_COUNT; arm++) {
        axis[arm].test();
    }
}

//Blinks out the IP address of the machine on the blue LED
void Maslow_::blinkIPAddress() {
    static size_t        currentChar   = 0;
    static int           currentBlink  = 0;
    static unsigned long lastBlinkTime = 0;
    static bool          inPause       = false;

    int shortMS = 400;
    int longMS  = 500;
    int pauseMS = 2000;

    std::string IP_String = WebUI::wifi_config.getIP();

    if (currentChar >= IP_String.length()) {
        currentChar   = 0;
        currentBlink  = 0;
        lastBlinkTime = 0;
        inPause       = false;
        digitalWrite(WIFILED, LOW);
        return;
    }

    char c = IP_String[currentChar];
    if (isdigit(c)) {
        int blinkCount = c - '0';
        if (currentBlink < blinkCount * 2) {
            if (millis() - lastBlinkTime >= shortMS) {
                //log_info("Blinking Digit: " << c);
                digitalWrite(WIFILED, currentBlink % 2 == 0 ? HIGH : LOW);
                currentBlink++;
                lastBlinkTime = millis();
            }
        } else if (!inPause) {
            inPause       = true;
            lastBlinkTime = millis();
        } else if (millis() - lastBlinkTime >= pauseMS) {
            inPause = false;
            currentChar++;
            currentBlink = 0;
        }
    } else if (c == '.') {
        if (millis() - lastBlinkTime >= longMS) {
            digitalWrite(WIFILED, LOW);
            currentChar++;
            currentBlink = 0;
        } else {
            digitalWrite(WIFILED, HIGH);
        }
    }
}

//Print the motor currents. Used for monitioring the power consumption of each motor.
void Maslow_::print_motor_currents() {
    if (!debugEnabled) {
        return;
    }

    static unsigned long lastExecutionTime = 0;
    unsigned long        currentTime       = millis();

    if (currentTime - lastExecutionTime >= 1000) {
        log_info("TLC: " << axis[_TL].getMotorCurrent() << " TRC: " << axis[_TR].getMotorCurrent()
                         << " BLC: " << axis[_BL].getMotorCurrent() << " BRC: " << axis[_BR].getMotorCurrent());
        lastExecutionTime = currentTime;
    }
}

//------------------------------------------------------
//------------------------------------------------------ Stops    TODO: Do we need all of these? Can some be combigned or reduced?
//------------------------------------------------------

// Resets variables on all 4 axis
void Maslow_::reset_all_axis() {
    for (int arm = _TL; arm < ARM_COUNT; arm++) {
        axis[arm].reset();
    }
}

// Stop all motors and reset all state variables
void Maslow_::stop() {
    stopMotors();
    calibration.calibrationInProgress = false;
    test                              = false;
    takeSlack                         = false;

    for (int arm = _TL; arm < ARM_COUNT; arm++) {
        axis[arm].reset();
    }

    // if we are stopping, stop any running job too
    allChannels.stopJob();
}

// Stop all the motors
void Maslow_::stopMotors() {
    axis[_BL].stop();
    axis[_BR].stop();
    axis[_TR].stop();
    axis[_TL].stop();
}

// Safe Z height in mm above Z home to raise to after stop (prevents workpiece damage)
static constexpr float Z_SAFE_HEIGHT_MM = 2.0f;

// Raises Z axis to Z home + Z_SAFE_HEIGHT_MM to prevent workpiece damage after stop
void Maslow_::raiseZ() {
    // Always stop streaming and clear the planner/stepper immediately, regardless of Z height.
    // If we only stop the job without clearing, any moves already in the planner buffer
    // will resume executing after maslow_stop() returns, causing the machine to keep moving.
    allChannels.stopJob();
    sys.step_control = {};
    plan_reset();
    Stepper::reset();

    // Sync belt motor step positions to actual encoder positions.
    // Maslow.update() uses get_axis_motor_steps() as belt PID targets.  If the
    // commanded step position is ahead of the encoder position when stop is pressed
    // (i.e. the PID had not finished tracking the last move), the PID would continue
    // driving the belt motors after the stop to close that error — effectively
    // completing one last motion segment.  Updating _steps to the encoder-derived
    // position ensures the PID target equals the current physical position so the
    // error is immediately zero and no further belt motion occurs.
    for (int arm = _TL; arm < ARM_COUNT; arm++) {
        set_motor_steps(arm, mpos_to_steps((float)axis[arm].getPosition(), arm));
        // Also reset the PID integral accumulator.  Even with target == position (zero
        // P-error), the I-term built up during cutting would still drive the motors.
        axis[arm].resetPID();
    }

    gc_sync_position();
    plan_sync_position();

    // Clear any pending suspend bits (e.g. holdComplete from a prior feed hold) before
    // transitioning to Idle.  If left set, protocol_exec_rt_suspend() would loop indefinitely
    // after maslow_stop() returns, preventing any further commands from being processed.
    auto suspend  = sys.suspend();
    suspend.value = 0;
    sys.set_suspend(suspend);
    sys.set_state(State::Idle);

    float* mpos  = get_mpos();
    float* wco   = get_wco();
    float  workZ = mpos[Z_AXIS] - wco[Z_AXIS];  // Work Z = machine Z minus WCO
    if (workZ >= Z_SAFE_HEIGHT_MM) {
        return;  // Z is already at or above safe height in work coordinates
    }
    log_info("Raising Z from work Z " << workZ << "mm to " << Z_SAFE_HEIGHT_MM << "mm (Z home + " << Z_SAFE_HEIGHT_MM << "mm)");

    // Command Z to raise to Z_SAFE_HEIGHT_MM in work coordinates.
    // Convert to the current unit system so the G-code interpreter moves the
    // correct distance regardless of whether G20 (inches) or G21 (mm) is active.
    char  zRaise[20];
    float safeHeight = (gc_state.modal.units == Units::Inches) ? Z_SAFE_HEIGHT_MM / MM_PER_INCH : Z_SAFE_HEIGHT_MM;
    snprintf(zRaise, sizeof(zRaise), "G90 G0 Z%.4f", safeHeight);
    Error result = gc_execute_line(zRaise);
    if (result == Error::Ok) {
        protocol_buffer_synchronize();  // Wait for Z to reach target
    } else {
        log_error("Failed to raise Z: " << errorString(result));
    }
}

static void stopEverything() {
    sys.set_state(State::Alarm);
    protocol_disable_steppers();
}

// Panic function, stops all motors and sets state to alarm
void Maslow_::panic() {
    panicCount++;
    stop();
    stopEverything();
}

// Reset the update watchdog timer to prevent false emergency stops during
// intentional blocking operations (e.g. writing config to LittleFS).
void Maslow_::resetUpdateWatchdog() {
    lastCallToUpdate = millis();
}

// Clears a latched error or watchdog condition so the machine can be used again
// without a power cycle.  Both latches make update() return early forever, so the
// red LED blinks and all motion is refused until something clears them; $X is the
// command the user already reaches for to acknowledge an alarm, so it clears them
// here.  Returns true if a latched condition was actually cleared.
bool Maslow_::clearError() {
    // The LED is driven low unconditionally: if nothing is latched it is already off,
    // and this also picks up the case where a blink left it mid-cycle.
    digitalWrite(REDLED, LOW);

    if (!error && !watchdogFired) {
        return false;
    }

    if (watchdogFired) {
        log_warn("Clearing update watchdog. Motion is enabled again - if this repeats, find what is blocking the "
                 "processor before running a job");
        digitalWrite(WIFILED, LOW);  // the watchdog pattern blinks this one too
    }
    if (error) {
        log_warn("Clearing error state. Motion is enabled again - make sure the cause was fixed, then re-check belt "
                 "tension and machine position before cutting");
    }

    error         = false;
    watchdogFired = false;
    errorMessage  = "";

    // Both early returns skip the point where lastCallToUpdate is refreshed, so by now it
    // is far in the past.  Without this the update watchdog re-fires on the very next call
    // and the LED comes straight back on.
    resetUpdateWatchdog();

    return true;
}

//Emergency Stop
void Maslow_::eStop(String message) {
    log_error("Emergency stop! Stopping all motors");
    log_warn("The machine will not respond until turned off and back on again");
    stop();
    error        = true;
    errorMessage = message;
    stopEverything();
}

//Clear error state and turn off the RED LED
void Maslow_::clearError() {
    error = false;
    errorMessage = "";
    digitalWrite(REDLED, LOW);
}

//This is the function that should prevent machine from damaging itself
void Maslow_::safety_control() {
    //We need to keep track of average belt speeds and motor currents for every axis
    static bool          tick[4]                 = { false, false, false, false };
    static unsigned long spamTimer               = millis();
    static int           tresholdHitsBeforePanic = 150;
    static int           panicCounter[4]         = { 0 };

    static int   positionErrorCounter[4]  = { 0 };
    static float previousPositionError[4] = { 0, 0, 0, 0 };

    for (int i = 0; i < 4; i++) {
        //If the current exceeds some absolute value, we need to call panic() and stop the machine
        if (axis[i].getMotorCurrent() > 4000 && !tick[i]) {
            panicCounter[i]++;
            if (panicCounter[i] > tresholdHitsBeforePanic) {
                if (sys.state() == State::Jog || sys.state() == State::Cycle) {
                    log_warn("Motor current on " << axis_id_to_label(i).c_str() << " axis exceeded threshold of " << 4000);
                    //Maslow.panic();
                }
                tick[i] = true;
            }
        } else {
            panicCounter[i] = 0;
        }

        //If the motor torque is high, but the belt is not moving
        //  if motor is moving IN, this means the axis is STALL, we should warn the user and lower torque to the motor
        //  if the motor is moving OUT, that means the axis has SLACK, so we should warn the user and stop the motor, until the belt starts moving again
        // don't spam log, no more than once every 5 seconds

        static int axisSlackCounter[4] = { 0, 0, 0, 0 };

        axisSlackCounter[i] = 0;  //TEMP
        if (axis[i].getMotorPower() > 450 && abs(axis[i].getBeltSpeed()) < 0.1 && !tick[i]) {
            axisSlackCounter[i]++;
            if (axisSlackCounter[i] > 3000) {
                // log_info("SLACK:" << axis_id_to_label(i).c_str() << " motor power is " << int(axis[i].getMotorPower())
                //                   << ", but the belt speed is" << axis[i].getBeltSpeed());
                // log_info(axisSlackCounter[i]);
                // log_info("Pull on " << axis_id_to_label(i).c_str() << " and restart!");
                tick[i]             = true;
                axisSlackCounter[i] = 0;
                Maslow.panic();
            }
        } else
            axisSlackCounter[i] = 0;

        //If the motor has a position error greater than 1mm and we are running a file or jogging
        if ((abs(axis[i].getPositionError()) > 1) && (sys.state() == State::Jog || sys.state() == State::Cycle) && !tick[i]) {
            // log_error("Position error on " << axis_id_to_label(i).c_str() << " axis exceeded 1mm, error is " << axis[i].getPositionError()
            //                                << "mm");
            tick[i] = true;
        }

        //If the motor has a position error greater than 15mm and we are running a file or jogging
        previousPositionError[i] = axis[i].getPositionError();
        if ((abs(axis[i].getPositionError()) > 15) && (sys.state() == State::Cycle)) {
            positionErrorCounter[i]++;
            log_warn("Position error on " << axis_id_to_label(i).c_str() << " axis exceeded 15mm while running. Error is "
                                          << axis[i].getPositionError() << "mm" << " Counter: " << positionErrorCounter[i]);
            log_warn("Previous error was " << previousPositionError[i] << "mm");

            if (positionErrorCounter[i] > 5) {
                Maslow.eStop("Position error > 15mm while running. E-Stop triggered.");
            }
        } else {
            positionErrorCounter[i] = 0;
        }
    }

    if (millis() - spamTimer > 5000) {
        for (int i = 0; i < 4; i++) {
            tick[i] = false;
        }
        spamTimer = millis();
    }
}

//---------------
// Telemetry
//---------------

// Prints out state
void Maslow_::getInfo() {
    char* buffer = getLogBuffer();
    snprintf(buffer,
             1400,
             "MINFO: { \"homed\": %s, \"calibrationInProgress\": %s, \"tl\": %g, \"tr\": %g, \"br\": %g, \"bl\": %g, "
             "\"etl\": %g, \"etr\": %g, \"ebr\": %g, \"ebl\": %g, \"extended\": %s }",
             calibration.all_axis_homed() ? "true" : "false",
             calibration.calibrationInProgress ? "true" : "false",
             axis[_TL].getPosition(),
             axis[_TR].getPosition(),
             axis[_BR].getPosition(),
             axis[_BL].getPosition(),
             axis[_TL].getPositionError(),
             axis[_TR].getPositionError(),
             axis[_BR].getPositionError(),
             axis[_BL].getPositionError(),
             calibration.allAxisExtended() ? "true" : "false");
    log_data(buffer);
    releaseLogBuffer();
}

void Maslow_::set_telemetry(bool enabled) {
    if (enabled) {
        // Start off the file with the length of each struct in it.
        FileStream* file = new FileStream(MASLOW_TELEM_FILE, "w", "sd");
        // write header
        TelemetryFileHeader header;
        header.structureSize = sizeof(TelemetryData);
        strncpy(header.version, VERSION_NUMBER, sizeof(header.version) - 1);
        header.version[sizeof(header.version) - 1] = '\0';  // Ensure null termination
        file->write(reinterpret_cast<uint8_t*>(&header), sizeof(TelemetryFileHeader));
        file->flush();
        delete file;
    } else {
        // TODO: not sure why this fails to find the file
        // std::string filePath = MASLOW_TELEM_FILE;
        // std::string newFilePath = filePath + "." + std::to_string(millis());
        // std::error_code ec;
        // log_info("renaming file: " + filePath + " to " + newFilePath);
        // stdfs::rename(filePath, newFilePath, ec);
        // if (ec) {
        //     log_error(std::string("Error renaming file: ") + ec.message());
        // }
    }
    telemetry_enabled = enabled;
    log_info("Telemetry: " << (enabled ? "enabled" : "disabled"));
}

void Maslow_::log_telem_hdr_csv() {
    log_data("millis," << "Current[_TL]," << "Current[_TR]," << "Current[_BL]," << "Current[_BR]," << "Power[_TL]," << "Power[_TR],"
                       << "Power[_BL]," << "Power[_BR]," << "Speed[_TL]," << "Speed[_TR]," << "Speed[_BL]," << "Speed[_BR]," << "Pos[_TL],"
                       << "Pos[_TR]," << "Pos[_BL]," << "Pos[_BR]," << "extended[_TL]," << "extended[_TR]," << "extended[_BL],"
                       << "extended[_BR]," << "extendingALL," << "complyALL," << "takeSlack," << "safetyOn," << "targetX," << "targetY,"
                       << "targetZ," << "x," << "y," << "test," << "pointCount," << "waypoint," << "calibrationGridSize," << "holdTimer,"
                       << "holding," << "holdTime," << "centerX," << "centerY," << "lastCallToPID," << "lastMiss," << "lastCallToUpdate,"
                       << "extendCallTimer," << "complyCallTimer," << "panicCount");
}

void Maslow_::log_telem_pt_csv(TelemetryData data) {
    // Use stack-allocated buffer with snprintf to avoid heap allocations from std::to_string
    char buffer[512];
    snprintf(buffer,
             sizeof(buffer),
             "%lu,%g,%g,%g,%g,%g,%g,%g,%g,%g,%g,%g,%g,%g,%g,%g,%g,%d,%d,%d,%d,%d,%d,%d,%d,%g,%g,%g,%g,%g,%d,%d,%d,%d,%lu,%d,%lu,%g,%g,%lu,%"
             "lu,%lu,%lu,%lu,%u",
             data.timestamp,
             data.Current[_TL],
             data.Current[_TR],
             data.Current[_BL],
             data.Current[_BR],
             data.Power[_TL],
             data.Power[_TR],
             data.Power[_BL],
             data.Power[_BR],
             data.Speed[_TL],
             data.Speed[_TR],
             data.Speed[_BL],
             data.Speed[_BR],
             data.Pos[_TL],
             data.Pos[_TR],
             data.Pos[_BL],
             data.Pos[_BR],
             data.extended[_TL],
             data.extended[_TR],
             data.extended[_BL],
             data.extended[_BR],
             data.extendingALL,
             data.complyALL,
             data.takeSlack,
             data.safetyOn,
             data.targetX,
             data.targetY,
             data.targetZ,
             data.x,
             data.y,
             data.test,
             data.pointCount,
             data.waypoint,
             data.calibrationGridSize,
             data.holdTimer,
             data.holding,
             data.holdTime,
             data.centerX,
             data.centerY,
             data.lastCallToPID,
             data.lastMiss,
             data.lastCallToUpdate,
             data.extendCallTimer,
             data.complyCallTimer,
             data.panicCount);
    log_data(buffer);
}

TelemetryData Maslow_::get_telemetry_data() {
    TelemetryData data;

    // TODO: probably, we ought to use mutexes here?, but it is not implemented yet and
    // it may not matter much. the reads are generally of types that don't
    //if (xSemaphoreTake(telemetry_mutex, portMAX_DELAY)) {
    // Access shared variables here
    data.timestamp    = millis();
    data.Current[_TL] = axis[_TL].getMotorCurrent();
    data.Current[_TR] = axis[_TR].getMotorCurrent();
    data.Current[_BL] = axis[_BL].getMotorCurrent();
    data.Current[_BR] = axis[_BR].getMotorCurrent();

    data.Power[_TL] = axis[_TL].getMotorPower();
    data.Power[_TR] = axis[_TR].getMotorPower();
    data.Power[_BL] = axis[_BL].getMotorPower();
    data.Power[_BR] = axis[_BR].getMotorPower();

    data.Speed[_TL] = axis[_TL].getBeltSpeed();
    data.Speed[_TR] = axis[_TR].getBeltSpeed();
    data.Speed[_BL] = axis[_BL].getBeltSpeed();
    data.Speed[_BR] = axis[_BR].getBeltSpeed();

    data.Pos[_TL] = axis[_TL].getPosition();
    data.Pos[_TR] = axis[_TR].getPosition();
    data.Pos[_BL] = axis[_BL].getPosition();
    data.Pos[_BR] = axis[_BR].getPosition();

    data.extended[_TL] = extended[_TL];
    data.extended[_TR] = extended[_TR];
    data.extended[_BL] = extended[_BL];
    data.extended[_BR] = extended[_BR];
    data.extendingALL  = (calibration.getCurrentState() == EXTENDING);
    data.complyALL     = (calibration.getCurrentState() == RELEASE_TENSION);
    data.takeSlack     = takeSlack;
    data.safetyOn      = safetyOn;
    data.targetX       = targetX;
    data.targetY       = targetY;
    data.targetZ       = targetZ;
    data.x             = x;
    data.y             = y;
    data.test          = test;
    // data.pointCount          = calibration.pointCount;
    // data.waypoint            = calibration.waypoint;
    data.calibrationGridSize = calibration.calibrationGridSize;
    data.holdTimer           = calibration.holdTimer;
    data.holding             = calibration.holding;
    data.holdTime            = calibration.holdTime;
    using namespace Kinematics;
    MaslowKinematics* kinematics = getMaslowKinematics();
    data.centerX                 = kinematics ? kinematics->getCenterX() : 0.0f;
    data.centerY                 = kinematics ? kinematics->getCenterY() : 0.0f;
    data.lastCallToPID           = lastCallToPID;
    data.lastMiss                = lastMiss;
    data.lastCallToUpdate        = lastCallToUpdate;
    data.extendCallTimer         = extendCallTimer;
    data.complyCallTimer         = complyCallTimer;
    data.panicCount              = panicCount;
    // xSemaphoreGive(telemetry_mutex);
    //}
    return data;
}
void Maslow_::write_telemetry_buffer(uint8_t* buffer, size_t length) {
    // Open the file in append mode
    FileStream* file = new FileStream(MASLOW_TELEM_FILE, "a", "sd");

    // Write the buffer to the file
    file->write(buffer, length);
    file->flush();

    // Close the file
    delete file;
}

void Maslow_::dump_telemetry(const char* file) {
    log_info("Dumping telemetry...");
    vTaskDelay(2000 / portTICK_PERIOD_MS);
    // open the file
    FileStream* f = new FileStream(MASLOW_TELEM_FILE, "r", "sd");
    if (f) {
        // read the size of each struct from the file
        TelemetryFileHeader header;
        f->read(reinterpret_cast<char*>(&header), sizeof(TelemetryFileHeader));
        log_info("Struct size " << header.structureSize);
        log_info("Dump version " << header.version);
        log_telem_hdr_csv();
        // TODO: check version and adapt?
        TelemetryData* data   = new TelemetryData();
        char*          buffer = new char[header.structureSize];
        while (f->available()) {
            f->read(&buffer[0], header.structureSize);
            // populate data from buffer
            memcpy(data, buffer, header.structureSize);
            // print the data
            log_telem_pt_csv(*data);
            // log_telem_pt(*data);
        }
        // delete the buffer
        delete[] buffer;
        // delete the data
        delete data;
    } else {
        log_info("File not found")
    }
    delete f;
}

// Called on utility core as a task to gather telemetry and write it to an SD log
void telemetry_loop(void* unused) {
    const int bufferSize = 5000;
    uint8_t   buffer[bufferSize];
    int       bufferIndex = 0;

    while (true) {
        if (Maslow.telemetry_enabled) {
            TelemetryData data = Maslow.get_telemetry_data();

            // Copy the telemetry data into the buffer
            memcpy(buffer + bufferIndex, reinterpret_cast<uint8_t*>(&data), sizeof(TelemetryData));
            // increment the index
            bufferIndex += sizeof(TelemetryData);

            // Check if the buffer is about to overflow
            if (bufferIndex >= bufferSize) {
                log_debug("!" << bufferIndex);
                Maslow.write_telemetry_buffer(buffer, bufferIndex);
                bufferIndex = 0;
            }
        } else {
            if (bufferIndex > 0) {
                Maslow.write_telemetry_buffer(buffer, bufferIndex);
                bufferIndex = 0;
            }
        }
        // Start with 2Hz-ish
        vTaskDelay(500 / portTICK_PERIOD_MS);
    }
}

Maslow_& Maslow_::getInstance() {
    static Maslow_ instance;
    return instance;
}

Maslow_& Maslow = Maslow.getInstance();
